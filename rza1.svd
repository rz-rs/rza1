# RZ/A1H register map
Vendor: Renesas
Registers are 32-bit, read-write, reset 0x0 unless marked. A register's access mark holds for its fields unless they carry their own. Offsets are from the block's base; [hi:lo] are bit positions; {n}, {i} and the like mark numbered series.

## VDC50
Base 0xFCFF7400
Same registers: VDC51 0xFCFF9400
0x00 INP_UPDATE
0x04 INP_SEL_CNT
0x08 INP_EXT_SYNC_CNT
0x0C INP_VSYNC_PH_ADJ
0x10 INP_DLY_ADJ
0x80 IMGCNT_UPDATE
0x84 IMGCNT_NR_CNT0
0x88 IMGCNT_NR_CNT1
0xA0 IMGCNT_MTX_MODE
0xA4 IMGCNT_MTX_YG_ADJ0
0xA8 IMGCNT_MTX_YG_ADJ1
0xAC IMGCNT_MTX_CBB_ADJ0
0xB0 IMGCNT_MTX_CBB_ADJ1
0xB4 IMGCNT_MTX_CRR_ADJ0
0xB8 IMGCNT_MTX_CRR_ADJ1
0xC0 IMGCNT_DRC_REG
0x100 SC0_SCL0_UPDATE
{0x100+4i} SC0_SCL0_FRC{i} (i=1..7)
0x124 SC0_SCL0_FRC9
0x128 SC0_SCL0_MON0 16-bit
0x12A SC0_SCL0_INT 16-bit
{0x128+4i} SC0_SCL0_DS{i} (i=1..7)
{0x144+4i} SC0_SCL0_US{i} (i=1..8)
0x16C SC0_SCL0_OVR1
0x180 SC0_SCL1_UPDATE
{0x184+4i} SC0_SCL1_WR{i} (i=1..4)
{0x188+4i} SC0_SCL1_WR{i} (i=5..11)
0x1B8 SC0_SCL1_MON1
{0x1BC+4i} SC0_SCL1_PBUF{i} (i=0..3)
0x1CC SC0_SCL1_PBUF_FLD
0x1D0 SC0_SCL1_PBUF_CNT
0x200 GR0_UPDATE
0x204 GR0_FLM_RD
{0x204+4i} GR0_FLM{i} (i=1..6)
{0x21C+4i} GR0_AB{i} (i=1..3)
{0x21C+4i} GR0_AB{i} (i=7..11)
0x24C GR0_BASE
0x250 GR0_CLUT
0x280 ADJ0_UPDATE
0x284 ADJ0_BKSTR_SET
{0x284+4i} ADJ0_ENH_TIM{i} (i=1..3)
{0x290+4i} ADJ0_ENH_SHP{i} (i=1..6)
0x2AC ADJ0_ENH_LTI1
0x2B0 ADJ0_ENH_LTI2
0x2B4 ADJ0_MTX_MODE
0x2B8 ADJ0_MTX_YG_ADJ0
0x2BC ADJ0_MTX_YG_ADJ1
0x2C0 ADJ0_MTX_CBB_ADJ0
0x2C4 ADJ0_MTX_CBB_ADJ1
0x2C8 ADJ0_MTX_CRR_ADJ0
0x2CC ADJ0_MTX_CRR_ADJ1
0x300 GR2_UPDATE
0x304 GR2_FLM_RD
{0x304+4i} GR2_FLM{i} (i=1..6)
{0x31C+4i} GR2_AB{i} (i=1..11)
0x34C GR2_BASE
0x350 GR2_CLUT
0x354 GR2_MON
0x380 GR3_UPDATE
0x384 GR3_FLM_RD
{0x384+4i} GR3_FLM{i} (i=1..6)
{0x39C+4i} GR3_AB{i} (i=1..11)
0x3CC GR3_BASE
0x3D0 GR3_CLUT_INT
0x3D4 GR3_MON
0x400 GAM_G_UPDATE
0x404 GAM_SW
{0x404+4i} GAM_G_LUT{i} (i=1..16)
{0x444+4i} GAM_G_AREA{i} (i=1..8)
0x480 GAM_B_UPDATE
{0x484+4i} GAM_B_LUT{i} (i=1..16)
{0x4C4+4i} GAM_B_AREA{i} (i=1..8)
0x500 GAM_R_UPDATE
{0x504+4i} GAM_R_LUT{i} (i=1..16)
{0x544+4i} GAM_R_AREA{i} (i=1..8)
0x580 TCON_UPDATE
0x584 TCON_TIM
0x588 TCON_TIM_STVA1
0x58C TCON_TIM_STVA2
0x590 TCON_TIM_STVB1
0x594 TCON_TIM_STVB2
0x598 TCON_TIM_STH1
0x59C TCON_TIM_STH2
0x5A0 TCON_TIM_STB1
0x5A4 TCON_TIM_STB2
0x5A8 TCON_TIM_CPV1
0x5AC TCON_TIM_CPV2
0x5B0 TCON_TIM_POLA1
0x5B4 TCON_TIM_POLA2
0x5B8 TCON_TIM_POLB1
0x5BC TCON_TIM_POLB2
0x5C0 TCON_TIM_DE
0x600 OUT_UPDATE
0x604 OUT_SET
0x608 OUT_BRIGHT1
0x60C OUT_BRIGHT2
0x610 OUT_CONTRAST
0x614 OUT_PDTHA
0x624 OUT_CLK_PHASE
{0x67C+4i} SYSCNT_INT{i} (i=1..6)
0x698 SYSCNT_PANEL_CLK 16-bit
0x69A SYSCNT_CLUT 16-bit
0x800 SC1_SCL0_UPDATE
{0x800+4i} SC1_SCL0_FRC{i} (i=1..7)
0x824 SC1_SCL0_FRC9
0x828 SC1_SCL0_MON0 16-bit
0x82A SC1_SCL0_INT 16-bit
{0x828+4i} SC1_SCL0_DS{i} (i=1..7)
{0x844+4i} SC1_SCL0_US{i} (i=1..8)
0x86C SC1_SCL0_OVR1
0x880 SC1_SCL1_UPDATE
{0x884+4i} SC1_SCL1_WR{i} (i=1..4)
{0x888+4i} SC1_SCL1_WR{i} (i=5..11)
0x8B8 SC1_SCL1_MON1
{0x8BC+4i} SC1_SCL1_PBUF{i} (i=0..3)
0x8CC SC1_SCL1_PBUF_FLD
0x8D0 SC1_SCL1_PBUF_CNT
0x900 GR1_UPDATE
0x904 GR1_FLM_RD
{0x904+4i} GR1_FLM{i} (i=1..6)
{0x91C+4i} GR1_AB{i} (i=1..11)
0x94C GR1_BASE
0x950 GR1_CLUT
0x954 GR1_MON
0x980 ADJ1_UPDATE
0x984 ADJ1_BKSTR_SET
{0x984+4i} ADJ1_ENH_TIM{i} (i=1..3)
{0x990+4i} ADJ1_ENH_SHP{i} (i=1..6)
0x9AC ADJ1_ENH_LTI1
0x9B0 ADJ1_ENH_LTI2
0x9B4 ADJ1_MTX_MODE
0x9B8 ADJ1_MTX_YG_ADJ0
0x9BC ADJ1_MTX_YG_ADJ1
0x9C0 ADJ1_MTX_CBB_ADJ0
0x9C4 ADJ1_MTX_CBB_ADJ1
0x9C8 ADJ1_MTX_CRR_ADJ0
0x9CC ADJ1_MTX_CRR_ADJ1
0xA00 GR_VIN_UPDATE
{0xA1C+4i} GR_VIN_AB{i} (i=1..7)
0xA4C GR_VIN_BASE
0xA54 GR_VIN_MON
0xA80 OIR_SCL0_UPDATE
{0xA80+4i} OIR_SCL0_FRC{i} (i=1..7)
{0xAA8+4i} OIR_SCL0_DS{i} (i=1..3)
0xAC4 OIR_SCL0_DS7
{0xAC4+4i} OIR_SCL0_US{i} (i=1..3)
0xAE4 OIR_SCL0_US8
0xAEC OIR_SCL0_OVR1
0xB00 OIR_SCL1_UPDATE
{0xB04+4i} OIR_SCL1_WR{i} (i=1..4)
{0xB08+4i} OIR_SCL1_WR{i} (i=5..7)
0xB80 GR_OIR_UPDATE
0xB84 GR_OIR_FLM_RD
{0xB84+4i} GR_OIR_FLM{i} (i=1..6)
{0xB9C+4i} GR_OIR_AB{i} (i=1..3)
{0xB9C+4i} GR_OIR_AB{i} (i=7..11)
0xBCC GR_OIR_BASE
0xBD0 GR_OIR_CLUT
0xBD4 GR_OIR_MON
